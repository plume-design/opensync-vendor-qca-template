## kconfig/Kconfig.vendor
```kconfig
menuconfig VENDOR_IS_QCA_TEMPLATE
    bool "QCA template"
    help
        OpenSync template vendor layer for QCA devices.
```

## qca-sdk/qsdk/package/opensync/Config.in
```kconfig
menu "OpenSync configuration"
	depends on PACKAGE_opensync

config OPENSYNC_TARGET
	string "Device TARGET specifier"
	default "OS_EXTENDER_QCA53"

config OPENSYNC_ONBOARD_SSID
	string "OpenSync onboarding network SSID"
	default "none"

config OPENSYNC_ONBOARD_PSK
	string "OpenSync onboarding network PSK"
	default "none"

endmenu
```

## src/lib/osp/kconfig/Kconfig.osp_unit.backend
```kconfig
config OSP_UNIT_QCA_TEMPLATE
    bool "QCA template Plume hardware example"
    help
        Example of OSP unit API implementation used by Plume hardware based
        targets from qca-template vendor layer.

if OSP_UNIT_QCA_TEMPLATE
    config OSP_UNIT_QCA_TEMPLATE_SERIAL_PREFIX
        string "Unit serial number prefix"
        default "OSx"
endif
```
